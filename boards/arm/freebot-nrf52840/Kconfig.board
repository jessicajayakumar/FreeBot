## boards/arm/freebot-nrf52840/Kconfig.board
```kconfig
# Copyright (c) 2024 Nordic Semiconductor ASA
# SPDX-License-Identifier: Apache-2.0

config BOARD_FREEBOT_NRF52840
	bool "FreeBot nRF52840"
	depends on SOC_NRF52840_QIAA
```

## boards/arm/freebot-nrf52840/Kconfig.defconfig
```kconfig
# Copyright (c) 2024 Nordic Semiconductor ASA
# SPDX-License-Identifier: Apache-2.0

if BOARD_FREEBOT_NRF52840

config BOARD
	default "freebot-nrf52840"

config BT_CTLR
   default BT


endif
```

## boards/arm/freebot-nrf52840/dts/bindings/nes,freebot-motors.yaml
```yaml
description: Motors for FreeBot
compatible: "nes,freebot-motors"

child-binding:
    description: A FreeBot motor
    properties:
        label:
            type: string
        in-a-gpios:
            type: phandle-array
            required: true
        in-b-gpios:
            type: phandle-array
            required: true
        hall-c1-gpios:
            type: phandle-array
            required: true
        hall-c2-gpios:
            type: phandle-array
            required: true
```

## boards/arm/freebot-nrf52840/dts/bindings/nes,freebot-powermanagement.yaml
```yaml
description: Power management for FreeBot
compatible: "nes,freebot-powermanagement"
properties:
    label:
        type: string
    io-channels:
        type: phandle-array
        required: true
    vin-measure-enable-gpios:
        type: phandle-array
        required: true
    vcap-measure-enable-gpios:
        type: phandle-array
        required: true
    vmotor-measure-enable-gpios:
        type: phandle-array
        required: true
    vout-enable-gpios:
        type: phandle-array
        required: true
```
